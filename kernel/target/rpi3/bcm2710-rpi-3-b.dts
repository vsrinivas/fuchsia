/dts-v1/;

/ {
    compatible = "brcm,bcm2710", "brcm,bcm2709";
    model = "Raspberry Pi 3 Model B";

    chosen {
        // need a dummy bootargs for bootloader to append to
        bootargs = "";
    };

    // empty node needed to make fastboot happy
    memory {};
};
